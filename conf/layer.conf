## conf/layer.conf
```bitbake
# We have a conf and classes directory, add to BBPATH
BBPATH .= ":${LAYERDIR}"

# We have recipes-* directories, add to BBFILES
BBFILES += "${LAYERDIR}/recipes-*/*/*.bb \
            ${LAYERDIR}/recipes-*/*/*.bbappend"

BBFILE_COLLECTIONS += "meta-raspberrypi-lade"
BBFILE_PATTERN_meta-raspberrypi-lade = "^${LAYERDIR}/"
BBFILE_PRIORITY_meta-raspberrypi-lade = "6"

LAYERDEPENDS_meta-raspberrypi-lade = "core"
LAYERSERIES_COMPAT_meta-raspberrypi-lade = "kirkstone"
```
